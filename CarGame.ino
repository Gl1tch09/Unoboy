//Highway CruZe
//Name: Hannan Mohammed Abdul
//Date: 01/14/2026 
//References: U8g2 Library:https://github.com/olikraus/u8g2/wiki/u8g2reference#drawxbm	INPUT Pullup: https://docs.arduino.cc/tutorials/generic/digital-input-pullup/   Video Used: https://www.youtube.com/watch?v=RmhiZg_6-Mo Random function: https://docs.arduino.cc/language-reference/en/functions/random-numbers/random/	Sprite Conversion: https://javl.github.io/image2cpp/

#include <U8g2lib.h>
#include <Wire.h>

U8G2_SSD1306_128X64_NONAME_F_HW_I2C u8g2(U8G2_R0, U8X8_PIN_NONE); // OLED initialization

const unsigned char tittleScreen[] PROGMEM = {
	0x00, 0x00, 0x00, 0x00, 0x00, 0x00, 0x00, 0x00, 0x00, 0x4c, 0x20, 0x05, 0x04, 0x00, 0x00, 0x00, 
	0x00, 0x00, 0x00, 0x00, 0x00, 0x00, 0x00, 0x00, 0x00, 0x4c, 0x20, 0x06, 0x04, 0x00, 0x00, 0x00, 
	0x00, 0x00, 0x00, 0x00, 0x00, 0x00, 0x00, 0x00, 0x00, 0x4c, 0x60, 0x84, 0x05, 0x00, 0x00, 0x00, 
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	0x00, 0x00, 0x00, 0x00, 0x00, 0x00, 0x00, 0x00, 0x00, 0x00, 0x00, 0x00, 0x80, 0x09, 0x8c, 0xb0
};

const unsigned char Car[] PROGMEM = { //Car Sprite
0xf8, 0x1f, 0x0c, 0x30, 0x32, 0x4c, 0x37, 0xec, 0x05, 0xa0, 0x05, 0xa0, 0x05, 0xa0, 0x07, 0xe0, 
	0xf2, 0x4f, 0x52, 0x4a, 0x32, 0x49, 0x92, 0x4c, 0xe7, 0xe7, 0x05, 0xa0, 0x05, 0xa0, 0x05, 0xa0, 
	0x07, 0xe0, 0x02, 0x40, 0x0c, 0x30, 0xf8, 0x1f, 0x10, 0x08, 0x10, 0x08, 0xfc, 0x3f, 0xfc, 0x3f
};

const unsigned char Road[] PROGMEM = {//Road Sprite
	0x00, 0x08, 0x01, 0x80, 0x00, 0x00, 0x00, 0x00, 0x00, 0x00, 0x00, 0x00, 0x01, 0x00, 0x00, 0x00, 
	0x00, 0x0c, 0x03, 0x80, 0x00, 0x00, 0x00, 0x00, 0x00, 0x00, 0x00, 0x00, 0x01, 0x00, 0x00, 0x00, 
	0x00, 0x04, 0x02, 0x80, 0x00, 0x00, 0x00, 0x00, 0x00, 0x00, 0x00, 0x00, 0x01, 0xc0, 0x1f, 0x00, 
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	0x00, 0x08, 0x01, 0x80, 0x00, 0x00, 0x00, 0x00, 0x00, 0x00, 0x00, 0x00, 0x81, 0x07, 0xe0, 0x01
};

const unsigned char Obstacle[] PROGMEM = { //Obstacle Sprite
0xf8, 0x1f, 0x0c, 0x30, 0x32, 0x4c, 0x37, 0xec, 0x05, 0xa0, 0x05, 0xa0, 0x05, 0xa0, 0x07, 0xe0, 
	0xf2, 0x4f, 0x52, 0x4a, 0x32, 0x49, 0x92, 0x4c, 0xe7, 0xe7, 0x05, 0xa0, 0x05, 0xa0, 0x05, 0xa0, 
	0x07, 0xe0, 0x02, 0x40, 0x0c, 0x30, 0xf8, 0x1f, 0x10, 0x08, 0x10, 0x08, 0xfc, 0x3f, 0xfc, 0x3f
};



int screenHeight = 64; 
int roadY = 0;

//Variabes for car characteristic
int carHeight = 24;
int carWidth = 16;
int carX = 64 - carWidth/2;
int carSpeed = 5;

//Variables for digital pins for input
int Left = 5;
int Right = 4;
int boost = 7;

int Rand;
int obstacleX = 38;
int obstacleY = -24;

bool gameState = 0;
	//Boot animation
void bootAnimation() {

  u8g2.setFont(u8g2_font_logisoso24_tf);

  int y = -30;        // start above screen
  int targetY = 38;   // final position

  while (y < targetY) {

    u8g2.clearBuffer();

    int textWidth = u8g2.getStrWidth("UNOBOY");
    int x = (128 - textWidth) / 2;

    u8g2.drawStr(x, y, "UNOBOY");

    u8g2.sendBuffer();

    y += 2;           // scroll speed
    delay(12);
  }

  delay(1000);         // pause before game starts
}


void setup() {
  // put your setup code here, to run once:
  u8g2.begin(); //Start the U8g2 library
	bootAnimation();
	//Reciving Input and using in-built pull up ressistor
  pinMode(Left, INPUT_PULLUP);
  pinMode(Right, INPUT_PULLUP);
	pinMode(boost, INPUT_PULLUP);

	randomSeed(analogRead(0));

//Check the state of the game and display the tittle screen
	if (gameState == 0);{
	u8g2.clearBuffer();
		u8g2.drawXBMP(0, 0, 128, 64, tittleScreen);
		u8g2.sendBuffer();
	}
}

void game(){
	u8g2.clearBuffer(); //Clear the prevoius frame

  roadY += carSpeed;

	obstacleY += carSpeed;

  // Reset Obstacle when it goes off screen
  if (obstacleY >= screenHeight) {
    obstacleY = -carHeight; // Reset to top (above screen)
    // Randomize position ONLY when resetting
    Rand = random(1, 3);
    if (Rand == 1) {
      obstacleX = 38;
    } else {
      obstacleX = 72;
    }
  }

//Infinite background scroll logic
 if (roadY >= screenHeight) {
  roadY -= screenHeight;
}

//Movement & Boost Logic
  if (digitalRead(Left) == LOW) {
    carX -= 2;
  }
  if (digitalRead(Right) == LOW) {
    carX += 2;
  }

	if (digitalRead(boost) == LOW) {
		carSpeed = 8;
  }
	else{
	carSpeed = 5;
	}

//Draw/Display everything
 
  u8g2.drawXBMP(0, roadY, 128, 64, Road); //Display Road
	u8g2.drawXBMP(0, roadY - screenHeight, 128, 64, Road); //Display Road

	u8g2.drawXBMP(obstacleX, obstacleY, carWidth, carHeight, Obstacle); //Display Obstacle

  u8g2.drawXBMP(carX, 26 + carHeight/2, carWidth, carHeight, Car);//Display Car
  u8g2.sendBuffer(); //Send the frame
}


void loop() {
 
	if (gameState == 0 && digitalRead(boost) == LOW){//Check if the game is in the tittle screen and if "A"/"Boost" is being pressed.
		u8g2.clearBuffer();
		gameState = 1;
	}
	else if (gameState == 1){//If the game is in playing state then start the game 
		game();
		delay(1);
	}
}
